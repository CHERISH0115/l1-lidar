#include "oled.h"
#include <string.h>
#include <stdarg.h>
#include <stdio.h>

/* 5x8 font for ASCII 0x20-0x5F (64 characters) */
static const uint8_t font5x8[64][5] = {
    {0x00,0x00,0x00,0x00,0x00}, /*   */
    {0x00,0x00,0x5F,0x00,0x00}, /* ! */
    {0x00,0x07,0x00,0x07,0x00}, /* " */
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    {0x40,0x40,0x40,0x40,0x40}, /* _ */
};

static uint8_t gram[OLED_PAGES][OLED_COLS];

#define I2C_TIMEOUT 10000

static void i2c_master_write(uint8_t addr_7bit, uint8_t *data, uint16_t len)
{
    uint32_t timeout;

    timeout = I2C_TIMEOUT;
    while (I2C_GetFlagStatus(I2C1, I2C_FLAG_BUSY) && --timeout);

    I2C_GenerateSTART(I2C1, ENABLE);
    timeout = I2C_TIMEOUT;
    while (!I2C_CheckEvent(I2C1, I2C_EVENT_MASTER_MODE_SELECT) && --timeout);

    I2C_Send7bitAddress(I2C1, addr_7bit << 1, I2C_Direction_Transmitter);
    timeout = I2C_TIMEOUT;
    while (!I2C_CheckEvent(I2C1, I2C_EVENT_MASTER_TRANSMITTER_MODE_SELECTED) && --timeout);

    uint16_t i;
    for (i = 0; i < len; i++) {
        I2C_SendData(I2C1, data[i]);
        timeout = I2C_TIMEOUT;
        while (!I2C_CheckEvent(I2C1, I2C_EVENT_MASTER_BYTE_TRANSMITTED) && --timeout);
    }

    I2C_GenerateSTOP(I2C1, ENABLE);
}

static void oled_write_cmd(uint8_t cmd)
{
    uint8_t buf[2] = {0x00, cmd};
    i2c_master_write(OLED_ADDR, buf, 2);
}

void oled_init(void)
{
    /* Wait for OLED power-up */
    {
        volatile uint32_t d;
        for (d = 0; d < 720000; d++) { __NOP(); }
    }

    oled_write_cmd(0xAE); /* display off */
    oled_write_cmd(0xD5); oled_write_cmd(0x80); /* osc freq */
    oled_write_cmd(0xA8); oled_write_cmd(0x3F); /* mux ratio */
    oled_write_cmd(0xD3); oled_write_cmd(0x00); /* display offset */
    oled_write_cmd(0x40); /* start line */
    oled_write_cmd(0x8D); oled_write_cmd(0x14); /* charge pump */
    oled_write_cmd(0x20); oled_write_cmd(0x00); /* horizontal addr mode */
    oled_write_cmd(0xA1); /* segment remap */
    oled_write_cmd(0xC8); /* COM scan direction */
    oled_write_cmd(0xDA); oled_write_cmd(0x12); /* COM pins */
    oled_write_cmd(0x81); oled_write_cmd(0xCF); /* contrast */
    oled_write_cmd(0xD9); oled_write_cmd(0xF1); /* pre-charge */
    oled_write_cmd(0xDB); oled_write_cmd(0x40); /* VCOMH */
    oled_write_cmd(0xA4); /* display on follow RAM */
    oled_write_cmd(0xA6); /* normal display */
    oled_write_cmd(0xAF); /* display on */

    oled_clear();
}

void oled_clear(void)
{
    memset(gram, 0, sizeof(gram));
    oled_refresh();
}

static void oled_write_data_bulk(const uint8_t *data, uint16_t len)
{
    uint32_t timeout;

    timeout = I2C_TIMEOUT;
    while (I2C_GetFlagStatus(I2C1, I2C_FLAG_BUSY) && --timeout);

    I2C_GenerateSTART(I2C1, ENABLE);
    timeout = I2C_TIMEOUT;
    while (!I2C_CheckEvent(I2C1, I2C_EVENT_MASTER_MODE_SELECT) && --timeout);

    I2C_Send7bitAddress(I2C1, OLED_ADDR << 1, I2C_Direction_Transmitter);
    timeout = I2C_TIMEOUT;
    while (!I2C_CheckEvent(I2C1, I2C_EVENT_MASTER_TRANSMITTER_MODE_SELECTED) && --timeout);

    /* Control byte 0x40: data stream with auto-increment */
    I2C_SendData(I2C1, 0x40);
    timeout = I2C_TIMEOUT;
    while (!I2C_CheckEvent(I2C1, I2C_EVENT_MASTER_BYTE_TRANSMITTED) && --timeout);

    uint16_t i;
    for (i = 0; i < len; i++) {
        I2C_SendData(I2C1, data[i]);
        timeout = I2C_TIMEOUT;
        while (!I2C_CheckEvent(I2C1, I2C_EVENT_MASTER_BYTE_TRANSMITTED) && --timeout);
    }

    I2C_GenerateSTOP(I2C1, ENABLE);
}

void oled_refresh(void)
{
    uint8_t page;
    for (page = 0; page < OLED_PAGES; page++) {
        oled_write_cmd(0xB0 | page);
        oled_write_cmd(0x00);
        oled_write_cmd(0x10);
        oled_write_data_bulk(gram[page], OLED_COLS);
    }
}

static void oled_draw_char(uint8_t row, uint8_t col, char c)
{
    if (c < 0x20 || c > 0x5F) c = ' ';
    uint8_t idx = (uint8_t)(c - 0x20);
    uint8_t i;
    for (i = 0; i < 5; i++) {
        if (col + i < OLED_COLS) {
            gram[row][col + i] = font5x8[idx][i];
        }
    }
    if (col + 5 < OLED_COLS) {
        gram[row][col + 5] = 0x00;
    }
}

void oled_printf(uint8_t row, const char *fmt, ...)
{
    char buf[22];
    va_list args;
    va_start(args, fmt);
    vsnprintf(buf, sizeof(buf), fmt, args);
    va_end(args);

    uint8_t col = 0;
    char *p = buf;
    while (*p && col < OLED_COLS) {
        oled_draw_char(row, col, *p);
        col += 6;
        p++;
    }
    while (col < OLED_COLS) {
        gram[row][col] = 0x00;
        col++;
    }
}
