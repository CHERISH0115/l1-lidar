#include "oled.h"
#include <stdio.h>
#include <stdarg.h>
#include <string.h>

/* ASCII 5×8 字体表（仅收录 0x20-0x7E）*/
static const uint8_t font5x8[][5] = {
    {0x00,0x00,0x00,0x00,0x00}, /* 空格 */
    {0x00,0x00,0x5F,0x00,0x00}, /* ! */
    {0x00,0x07,0x00,0x07,0x00}, /* " */
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    {0x32,0x49,0x79,0x41,0x3E}, /* @ */
};

static uint8_t gram[8][128]; /* GDDRAM 缓冲区 */

static void oled_write_cmd(uint8_t cmd) {
    uint8_t buf[2] = {0x00, cmd};
    HAL_I2C_Master_Transmit(&OLED_I2C, OLED_ADDR, buf, 2, 10);
}

static void oled_write_data(uint8_t dat) {
    uint8_t buf[2] = {0x40, dat};
    HAL_I2C_Master_Transmit(&OLED_I2C, OLED_ADDR, buf, 2, 10);
}

void oled_init(void) {
    HAL_Delay(100);
    oled_write_cmd(0xAE); /* 关闭显示 */
    oled_write_cmd(0xD5); oled_write_cmd(0x80);
    oled_write_cmd(0xA8); oled_write_cmd(0x3F);
    oled_write_cmd(0xD3); oled_write_cmd(0x00);
    oled_write_cmd(0x40);
    oled_write_cmd(0x8D); oled_write_cmd(0x14); /* 开启电荷泵 */
    oled_write_cmd(0x20); oled_write_cmd(0x00);
    oled_write_cmd(0xA1); /* 列扫描方向 */
    oled_write_cmd(0xC8); /* 行扫描方向 */
    oled_write_cmd(0xDA); oled_write_cmd(0x12);
    oled_write_cmd(0x81); oled_write_cmd(0xCF);
    oled_write_cmd(0xD9); oled_write_cmd(0xF1);
    oled_write_cmd(0xDB); oled_write_cmd(0x40);
    oled_write_cmd(0xA4);
    oled_write_cmd(0xA6); /* 正常显示 */
    oled_write_cmd(0xAF); /* 开启显示 */
    oled_clear();
}

void oled_clear(void) {
    memset(gram, 0, sizeof(gram));
    oled_refresh();
}

void oled_refresh(void) {
    for (uint8_t page = 0; page < 8; page++) {
        oled_write_cmd(0xB0 + page);
        oled_write_cmd(0x00);
        oled_write_cmd(0x10);
        for (uint8_t col = 0; col < 128; col++)
            oled_write_data(gram[page][col]);
    }
}

static void oled_draw_char(uint8_t row, uint8_t col, char c) {
    if (c < 0x20 || c > 0x60) c = ' ';
    const uint8_t *font = font5x8[c - 0x20];
    for (uint8_t i = 0; i < 5 && (col + i) < 128; i++) {
        gram[row][col + i] = font[i];
    }
    if (col + 5 < 128) gram[row][col + 5] = 0;
}

void oled_printf(uint8_t row, const char *fmt, ...) {
    char buf[22];
    va_list args;
    va_start(args, fmt);
    vsnprintf(buf, sizeof(buf), fmt, args);
    va_end(args);

    uint8_t col = 0;
    for (size_t i = 0; buf[i] && col < 128; i++, col += 6)
        oled_draw_char(row, col, buf[i]);
    /* 清除行尾 */
    while (col < 128) gram[row][col++] = 0;
    oled_refresh();
}
